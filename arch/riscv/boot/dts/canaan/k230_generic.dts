// SPDX-License-Identifier: GPL-2.0+
/*
 * Copyright (C) 2024 Yangyu Chen <cyy@cyyself.name>
 */
#include "k230.dtsi"

/ {
	model = "Kendryte K230 generic";

	chosen {
		stdout-path = "serial0";
	};
};

&uart0 {
	status = "okay";
};